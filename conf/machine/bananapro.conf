## conf/machine/bananapro.conf
```bitbake
#@TYPE: Machine
#@NAME: Bananapro
#@DESCRIPTION: Machine configuration for the bananapi pro, based on allwinner A20 CPU http://bananapi.org/

require conf/machine/include/sun7i.inc

KERNEL_DEVICETREE = "sun7i-a20-bananapro.dtb"
UBOOT_MACHINE = "Bananapro_config"
SUNXI_FEX_FILE = "sys_config/a20/BananaPro.fex"

MACHINE_FEATURES += "wifi"
MACHINE_EXTRA_RRECOMMENDS = "linux-firmware-brcm43362"
```
